## Kconfig
```
menuconfig LED_SUBSYSTEM
    bool "LED Subsystem"
    default y

if LED_SUBSYSTEM

choice
    prompt "LED blink period"
    default BLINK_SLEEP_1000MS

config BLINK_SLEEP_250MS
    bool "250ms (faster)"

config BLINK_SLEEP_500MS
    bool "500ms (fast)"

config BLINK_SLEEP_1000MS
    bool "1s (medium)"

config BLINK_SLEEP_2000MS
    bool "2s (slow)"

endchoice

config BLINK_SLEEP_TIME_MS
    int
    default 250 if BLINK_SLEEP_250MS
    default 500 if BLINK_SLEEP_500MS
    default 1000 if BLINK_SLEEP_1000MS
    default 2000 if BLINK_SLEEP_2000MS
    default 0

menuconfig ADVANCED_LED_SETTINGS
    bool "Advanced LED settings"
    default n

if ADVANCED_LED_SETTINGS

config LED_BRIGHTNESS
    int "LED brightness (0-100)"
    range 0 100
    default 100

config LED_FADE_DURATION
    int "LED fade duration (ms)"
    range 0 5000
    default 500

menu "Expert settings"
    visible if ADVANCED_LED_SETTINGS

config LED_DEBUG
    bool "Enable LED debugging"

config LED_CUSTOM_BLINK_PATTERN
    bool "Custom blink pattern"

endmenu

endif

endif




source "Kconfig.zephyr"
```

## prj.conf
```kconfig
CONFIG_GPIO=y
CONFIG_LOG=y

CONFIG_LED_SUBSYSTEM=y
CONFIG_BLINK_SLEEP_500MS=y
CONFIG_ADVANCED_LED_SETTINGS=y
CONFIG_LED_DEBUG=y
```

## app.overlay
```dts
/ {
	aliases {
		// app-led = &green_led_1;
		// app-led = &blue_led_2;
		app-led = &red_led_3;
	};
};
```

## src/main.cpp
```c
#include <zephyr/drivers/gpio.h>
#include <zephyr/kernel.h>
#include <zephyr/logging/log.h>

/* The devicetree node identifier for the "app-led" alias. */
#define LED_NODE DT_ALIAS(app_led)

static const struct gpio_dt_spec led = GPIO_DT_SPEC_GET(LED_NODE, gpios);

LOG_MODULE_REGISTER(main, LOG_LEVEL_INF);

int main(void)
{
    bool led_state = true;

    if (!gpio_is_ready_dt(&led)) return 0;

    if (gpio_pin_configure_dt(&led, GPIO_OUTPUT_ACTIVE) < 0) return 0;

    while (1)
    {
#if IS_ENABLED(CONFIG_LED_SUBSYSTEM)
            if (gpio_pin_toggle_dt(&led) < 0) return 0;

            led_state = !led_state;
            if (IS_ENABLED(CONFIG_LED_DEBUG))
            {
                LOG_INF("LED state: %s", led_state ? "ON" : "OFF");
            }
            k_msleep(CONFIG_BLINK_SLEEP_TIME_MS);
#endif
    }
    return 0;
}
```
